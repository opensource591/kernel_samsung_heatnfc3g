## kernel/trace/mark/Kconfig
```kconfig
#
# Samsung variant configurations.
#
# @author kumhyun.cho@samsung.com
# @since 2014.02.20

config TRACE_MARK
	bool
	default n

config TRACE_MARK_SYSCALL
	bool
	default n

config TRACE_MARK_NET_SKB_DUMP
	bool
	default n
```
